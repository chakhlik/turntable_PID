## sdkconfig.defaults.txt
```kconfig
# Оптимизация Wi-Fi
CONFIG_ESP_WIFI_STATIC_RX_BUFFER_NUM=12
CONFIG_ESP_WIFI_DYNAMIC_RX_BUFFER_NUM=32
CONFIG_ESP_WIFI_DYNAMIC_TX_BUFFER_NUM=32

# Отключаем ненужное для экономии памяти
CONFIG_ESP_WIFI_NVS_ENABLED=y

# Увеличиваем стек для задач
CONFIG_ESP_MAIN_TASK_STACK_SIZE=4096
CONFIG_ESP_SYSTEM_EVENT_TASK_STACK_SIZE=2304

# Отключаем IPv6 (не нужен)
CONFIG_LWIP_IPV6=n
```
